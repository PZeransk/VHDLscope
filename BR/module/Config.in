## BR/module/Config.in
```kconfig
source "$BR2_EXTERNAL_VHDLSCOPE_PATH/package/vhdlscope_module/Config.in"
source "$BR2_EXTERNAL_VHDLSCOPE_PATH/package/vhdlscope_app/Config.in"
```

## BR/module/package/vhdlscope_app/Config.in
```kconfig
config BR2_PACKAGE_VHDLSCOPE_APP
    bool "App for VHDLscope control"
    depends on BR2_LINUX_KERNEL
    help
      Application for controlling VHDLscope via linux kernel
```

## BR/module/package/vhdlscope_module/Config.in
```kconfig
comment "You need to enable BR2_LINUX_KERNEL for VHDLscope to work"
	depends on !BR2_LINUX_KERNEL
config BR2_PACKAGE_VHDLSCOPE_MODULE
    bool "module for VHDLscope control"
    depends on BR2_LINUX_KERNEL
    help
      VHDLscope module support

      see: datasheet VHDL code.
depends on BR2_LINUX_KERNEL
```
